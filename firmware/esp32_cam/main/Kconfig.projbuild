## firmware/esp32_cam/main/Kconfig.projbuild
```kconfig
menu "Kaniye camera node"
config CAM_WIFI_SSID
    string "WiFi SSID"
    default "your_wifi_ssid"
config CAM_WIFI_PASSWORD
    string "WiFi password"
    default "your_wifi_password"
config CAM_HTTP_PORT
    int "HTTP port"
    range 1 65535
    default 80
config CAM_SERVO_GPIO
    int "Pan servo GPIO"
    range 0 39
    default 14
config CAM_MJPEG_FPS
    int "Streaming frame rate"
    range 1 30
    default 10
endmenu
```

## firmware/home_esp32/main/Kconfig.projbuild
```kconfig
menu "Kaniye home controller"
config HOME_WIFI_SSID
    string "PC network WiFi SSID"
    default "your_wifi_ssid"
config HOME_WIFI_PASSWORD
    string "PC network WiFi password"
    default "your_wifi_password"
config HOME_SERVER_URL
    string "PC server command URL"
    default "http://192.168.1.50:8000/api/room/device"
config HOME_ROOM_ID
    string "Room identifier"
    default "living-room"
config HOME_DEVICE_ID
    string "Device identifier"
    default "home-esp32"
config HOME_COMMAND_TIMEOUT_MS
    int "Command timeout (ms)"
    range 100 10000
    default 1000
config HOME_PTT_ADC_CHANNEL
    int "Push-to-talk ADC channel"
    range 0 9
    default 6
config HOME_AUDIO_THRESHOLD
    int "Audio gate threshold"
    range 0 4095
    default 120
config HOME_RELAY_GPIO
    int "Accessory relay GPIO"
    range 0 39
    default 2
endmenu
```

## firmware/remote_esp32/main/Kconfig.projbuild
```kconfig
menu "Kaniye remote"
config REMOTE_ESPNOW_CHANNEL
    int "ESP-NOW channel"
    range 1 13
    default 1
config REMOTE_COMMAND_TIMEOUT_MS
    int "Failsafe timeout (ms)"
    range 100 10000
    default 500
config REMOTE_PTT_ADC_CHANNEL
    int "PTT ADC channel"
    range 0 9
    default 6
endmenu
```

## firmware/robot_esp32/main/Kconfig.projbuild
```kconfig
menu "Kaniye Robot Settings"

    config ROBOT_WIFI_SSID
        string "WiFi SSID"
        default "your_wifi_ssid"

    config ROBOT_WIFI_PASSWORD
        string "WiFi Password"
        default "your_wifi_password"

    config ROBOT_SERVER_HOST
        string "Robot server host"
        default "192.168.1.50"

    config ROBOT_SERVER_PORT
        int "Robot server port"
        range 1 65535
        default 8000

    config ROBOT_AUDIO_DMA_BUF_LEN
        int "Audio DMA buffer length (smaller is lower latency)"
        range 64 1024
        default 256

    config ROBOT_AUDIO_SELF_MONITOR
        bool "Include remote microphone in local monitor mix"
        default n

endmenu
```
